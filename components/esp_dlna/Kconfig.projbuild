## components/esp_dlna/Kconfig.projbuild
```kconfig
menu "ESP DLNA Configuration"

config MEDIA_PROTOCOL_LIB_ENABLE
    bool "Enable Media Protocol Library"
    default "y"

endmenu
```

## components/snapserver/Kconfig.projbuild
```kconfig
menu "snapserver Configuration"
    config SNAPSERVER_IPV4
        bool "IPV4"
        default y

    config SNAPSERVER_IPV6
        bool "IPV6"
        default n
        select SNAPSERVER_CONNECT_IPV6

    config SNAPSERVER_PORT
        int "Port"
        range 0 65535
        default 3333
        help
            Local port the example server will listen on.

    config SNAPSERVER_KEEPALIVE_IDLE
        int "TCP keep-alive idle time(s)"
        default 5
        help
            Keep-alive idle time. In idle time without receiving any data from peer, will send keep-alive probe packet

    config SNAPSERVER_KEEPALIVE_INTERVAL
        int "TCP keep-alive interval time(s)"
        default 5
        help
            Keep-alive probe packet interval time.

    config SNAPSERVER_KEEPALIVE_COUNT
        int "TCP keep-alive packet retry send counts"
        default 3
        help
            Keep-alive probe packet retry count.
endmenu
```

## main/Kconfig.projbuild
```kconfig
menu "DLNA App Configuration"


config WIFI_SSID
    string "WiFi SSID"
    default "myssid"
    help
	SSID (network name) for the example to connect to.

config WIFI_PASSWORD
    string "WiFi Password"
    default "mypassword"
    help
	WiFi password (WPA or WPA2) for the example to use.
	
config ESP_MAXIMUM_RETRY
    int "Maximum retry"
    default 5
    help
        Set the Maximum retry to avoid station reconnecting to the AP unlimited when the AP is really inexistent.

choice ESP_WIFI_SCAN_AUTH_MODE_THRESHOLD
    prompt "WiFi Scan auth mode threshold"
    default ESP_WIFI_AUTH_WPA2_PSK
    help
        The weakest authmode to accept in the scan mode.
        This value defaults to ESP_WIFI_AUTH_WPA2_PSK incase password is present and ESP_WIFI_AUTH_OPEN is used.
        Please select ESP_WIFI_AUTH_WEP/ESP_WIFI_AUTH_WPA_PSK incase AP is operating in WEP/WPA mode.

    config ESP_WIFI_AUTH_OPEN
        bool "OPEN"
    config ESP_WIFI_AUTH_WEP
        bool "WEP"
    config ESP_WIFI_AUTH_WPA_PSK
        bool "WPA PSK"
    config ESP_WIFI_AUTH_WPA2_PSK
        bool "WPA2 PSK"
    config ESP_WIFI_AUTH_WPA_WPA2_PSK
        bool "WPA/WPA2 PSK"
    config ESP_WIFI_AUTH_WPA3_PSK
        bool "WPA3 PSK"
    config ESP_WIFI_AUTH_WPA2_WPA3_PSK
        bool "WPA2/WPA3 PSK"
    config ESP_WIFI_AUTH_WAPI_PSK
        bool "WAPI PSK"
endchoice
	
config EXAMPLE_IPV4
    bool "IPV4"
    default y

config EXAMPLE_IPV6
    bool "IPV6"
    default n
    select EXAMPLE_CONNECT_IPV6

config EXAMPLE_PORT
    int "Port"
    range 0 65535
    default 3333
    help
        Local port the example server will listen on.

config EXAMPLE_KEEPALIVE_IDLE
    int "TCP keep-alive idle time(s)"
    default 5
    help
        Keep-alive idle time. In idle time without receiving any data from peer, will send keep-alive probe packet

config EXAMPLE_KEEPALIVE_INTERVAL
    int "TCP keep-alive interval time(s)"
    default 5
    help
        Keep-alive probe packet interval time.

config EXAMPLE_KEEPALIVE_COUNT
    int "TCP keep-alive packet retry send counts"
    default 3
    help
        Keep-alive probe packet retry count.

endmenu
```
